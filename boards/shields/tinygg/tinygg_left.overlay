/ {
    chosen {
        zmk,kscan = &kscan0;
    };
};

&kscan0 {
    label = "KS0";
    input-gpios = <&gpio0 10 (GPIO_PULL_UP | GPIO_ACTIVE_LOW)>,
                  <&gpio0 16 (GPIO_PULL_UP | GPIO_ACTIVE_LOW)>,
                  <&gpio0 14 (GPIO_PULL_UP | GPIO_ACTIVE_LOW)>,
                  <&gpio0 19 (GPIO_PULL_UP | GPIO_ACTIVE_LOW)>,
                  <&gpio0 18 (GPIO_PULL_UP | GPIO_ACTIVE_LOW)>,
                  <&gpio0 15 (GPIO_PULL_UP | GPIO_ACTIVE_LOW)>;
    output-gpios = <&gpio0 8 (GPIO_PULL_UP | GPIO_ACTIVE_LOW)>,
                   <&gpio0 7 (GPIO_PULL_UP | GPIO_ACTIVE_LOW)>,
                   <&gpio0 6 (GPIO_PULL_UP | GPIO_ACTIVE_LOW)>,
                   <&gpio0 5 (GPIO_PULL_UP | GPIO_ACTIVE_LOW)>;
};
